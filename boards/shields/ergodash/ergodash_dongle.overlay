/*
 * Copyright (c) 2024 The ZMK Contributors
 *
 * SPDX-License-Identifier: MIT
 */

/ {
    chosen {
        // USB CDC ACM을 콘솔 및 쉘로 사용
        zephyr,console = &cdc_acm_uart0;
        zephyr,shell-uart = &cdc_acm_uart0;

        // 동글에는 kscan이나 matrix_transform이 필요 없습니다.
        // zmk,kscan = &kscan0; // 이 줄이 있다면 삭제
        // zmk,matrix_transform = &default_transform; // 이 줄이 있다면 삭제
    };

    // 선택 사항: 동글에 LED가 있고 상태 표시등으로 사용하려는 경우
    /*
    leds {
        compatible = "gpio-leds";
        blue_led: led_0 {
            gpios = <&gpio0 13 GPIO_ACTIVE_LOW>; // XIAO BLE의 LED 핀에 맞게 조정 (예: P0.06)
            label = "Blue LED";
        };
    };

    zmk_led_state {
        compatible = "zmk,led-state-driver-gpio";
        // 예: BLE 활동 시 파란색 LED 깜빡임
        bindings = <&zmk_output_status_ble_0 &blue_led>;
    };
    */
};
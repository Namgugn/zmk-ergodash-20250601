## config/board/shields/ergodash/Kconfig.shield
```kconfig
# Copyright (c) 2022 The ZMK Contributors
# SPDX-License-Identifier: MIT

config SHIELD_ERGODASH_LEFT
    def_bool $(shields_list_contains,ergodash_left)

config SHIELD_ERGODASH_RIGHT
    def_bool $(shields_list_contains,ergodash_right)
```

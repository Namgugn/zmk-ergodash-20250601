/*
 * Copyright (c) 2022 The ZMK Contributors
 *
 * SPDX-License-Identifier: MIT
 */

#include "ergodash.dtsi"

/ {
    kscan0: kscan {
        compatible = "zmk,kscan-gpio-matrix";
        diode-direction = "col2row";

        row-gpios =
            <&gpio0 6  (GPIO_ACTIVE_HIGH | GPIO_PULL_DOWN)>
            , <&gpio0 8  (GPIO_ACTIVE_HIGH | GPIO_PULL_DOWN)>
            , <&gpio0 10 (GPIO_ACTIVE_HIGH | GPIO_PULL_DOWN)>
            , <&gpio0 12 (GPIO_ACTIVE_HIGH | GPIO_PULL_DOWN)>
            , <&gpio0 14 (GPIO_ACTIVE_HIGH | GPIO_PULL_DOWN)>
            , <&gpio0 16 (GPIO_ACTIVE_HIGH | GPIO_PULL_DOWN)>;

        col-gpios =
            <&gpio0 18 GPIO_ACTIVE_HIGH>
            , <&gpio0 20 GPIO_ACTIVE_HIGH>
            , <&gpio0 22 GPIO_ACTIVE_HIGH>
            , <&gpio0 24 GPIO_ACTIVE_HIGH>
            , <&gpio1 1  GPIO_ACTIVE_HIGH>
            , <&gpio1 3  GPIO_ACTIVE_HIGH>
            , <&gpio1 5  GPIO_ACTIVE_HIGH>;
    };

    physical_layout0: physical_layout_0 {
        compatible = "zmk,physical-layout";
        display-name = "ErgoDash Right";
        transform = <&default_transform>;
    };

    chosen {
        zmk,kscan = &kscan0;
        zmk,physical-layout = &physical_layout0;
    };
};
